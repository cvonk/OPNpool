## factory/main/Kconfig
```kconfig
config WIFI_CONNECT_SSID
    string "WiFi SSID"
    default ""
    help
        Leave empty for BLE provisioning.

config WIFI_CONNECT_PASSWD
    string "WiFi Password"
    default ""
    help
        Leave empty for BLE provisioning.
```

## factory/main/Kconfig.example
```kconfig
menu "OPNpool"

    config OTA_UPDATE_FIRMWARE_URL
        string "Firmware upgrade url endpoint"
        default "http://host.domain/path/interface.bin"
        help
            URL of server which hosts the firmware image. (make sure it matches Kconfig in interface dir)

    config OTA_UPDATE_RECV_TIMEOUT
        int "OTA Update receive Timeout"
        default 5000
        help
            Maximum time for reception [sec]

endmenu
```

## interface/components/coredump_to_server/test/sdkconfig.defaults
```kconfig
# to propegate changes in this file, delete `sdkconfig`

# ensure there is a coredump partition
CONFIG_PARTITION_TABLE_CUSTOM=y
CONFIG_PARTITION_TABLE_CUSTOM_FILENAME="partitions.csv"
CONFIG_PARTITION_TABLE_FILENAME="partitions.csv"

# need 4 MByte flash for OTA updates
CONFIG_ESPTOOLPY_FLASHSIZE_4MB=y

# coredumping
CONFIG_ESP32_ENABLE_COREDUMP_TO_FLASH=y
CONFIG_ESP32_COREDUMP_DATA_FORMAT_ELF=y
CONFIG_ESP32_CORE_DUMP_STACK_SIZE=1024
```

## interface/components/factory_reset_task/Kconfig
```kconfig
# erase sdkconfig after changing this file, so it gets rebuild
menu "Factory Reset"

    config FACTORY_RESET_PIN
        int "GPIO# used for Factory reset"
        default 0
        help
            GPIO pin on ESP32 that connects to a pull down switch.

    config FACTORY_RESET_SECONDS
        int "Factory reset key press duration"
        default 3
        help
            Number of seconds that GPIO needs to be hold low before triggering
            a factory reset (switch to factory app partition and erase WiFi credentials)

endmenu
```

## interface/components/ota_task/Kconfig
```kconfig
menu "Pool OTA Updates"

config OTA_FIRMWARE_URL
    string "firmware upgrade url endpoint"
    default "https://coertvonk.com/jvonk/pool/interface.bin"
    help
        URL of server which hosts the firmware
        image.
endmenu


config OTA_RECV_TIMEOUT
    int "OTA Receive Timeout"
    default 5000
    help
        Maximum time for reception
```

## interface/components/ota_update_task/Kconfig.example
```kconfig
menu "OTA Updates"

    config OTA_UPDATE_FIRMWARE_URL
        string "Firmware upgrade url endpoint"
        default "http://host:port/directory/ota_update_test.bin"
        help
            URL of server which hosts the firmware image.

    config OTA_UPDATE_RECV_TIMEOUT
        int "OTA Update receive Timeout"
        default 5000
        help
            Maximum time for reception [sec]

endmenu
```

## interface/components/ota_update_task/test/main/Kconfig.example
```kconfig
menu "OTA Updates"

    config WIFI_SSID
        string "WiFi SSID"
        default ""
        help
            SSID (network name). Leave empty for BLE provisioning.

    config WIFI_PASSWD
        string "WiFi Password"
        default ""
        help
            WiFi password (WPA or WPA2). Leave empty for BLE provisioning.

endmenu
```

## interface/components/ota_update_task/test/sdkconfig.defaults
```kconfig
# to propegate changes in this file, delete `sdkconfig`

# ensure there is a coredump partition
CONFIG_PARTITION_TABLE_CUSTOM=y
CONFIG_PARTITION_TABLE_CUSTOM_FILENAME="partitions.csv"
CONFIG_PARTITION_TABLE_FILENAME="partitions.csv"

# need 4 MByte flash for OTA updates
CONFIG_ESPTOOLPY_FLASHSIZE_4MB=y
```

## interface/components/reset_task/Kconfig
```kconfig
# erase sdkconfig after changing this file, so it gets rebuild
menu "RESET"

    config RESET_PIN
        int "RESET GPIO# on ESP32"
        default 0
        help
            RESET input GPIO pin on ESP32 that connects to a pull down switch.

    config RESET_SECONDS
        int "RESET press duration"
        default 3
        help
            Number of seconds that RESET needs to be hold low before triggering
            a factory reset (switch to factory app partition and erase WiFi credentials)

    endmenu
```

## interface/factory/main/Kconfig.projbuild
```kconfig
# erase sdkconfig after changing this file, so it gets rebuild
menu "Pool interface config"

config RESET_PROVISIONED
    bool
    default n
    prompt "Reset provisioned status of the device"
    help
    This erases the NVS to reset provisioned status of the device on every reboot.
    Provisioned status is determined by the WiFi STA configuration, saved on the NVS.

endmenu
```

## interface/main/Kconfig
```kconfig
menu "OPNpool"

    config OTA_UPDATE_FIRMWARE_URL
        string "Firmware upgrade url endpoint"
        default "http://coertvonk.com/cvonk/opnpool/interface.bin"
        help
            URL of server which hosts the firmware image. (make sure it matches Kconfig in factory dir)

    config OTA_UPDATE_RECV_TIMEOUT
        int "OTA Update receive Timeout"
        default 5000
        help
            Maximum time for reception [sec]

    config OPNPOOL_RS485_RXPIN
        int "RS485 Rx GPIO# on ESP32"
        default 25
        help
            Receive GPIO# on ESP32 that connects to RO on the RS-485 Transceiver

    config OPNPOOL_RS485_TXPIN
        int "RS485 Tx GPIO# on ESP32"
        default 26
        help
            Transmit GPIO# on ESP32 that connects to DI on the RS-485 Transceiver

    config OPNPOOL_RS485_RTSPIN
        int "RS485 RTS GPIO# on ESP32"
        default 27
        help
            Request-To-Send GPIO# on ESP32 that connects to DE/!RE on the RS-485 Transceiver

    config OPNPOOL_RS485_TIMEOUT
        int "RS485 timeout [ms]"
        default 100
        help
            Maximum time to wait for a byte on RS485

    config OPNPOOL_MQTT_DATA_TOPIC
        string "MQTT broker uri"
        default "opnpool/data"
        help
            MQTT topic for data from the Pool Interface

    config OPNPOOL_MQTT_CTRL_TOPIC
        string "MQTT broker uri"
        default "opnpool/ctrl"
        help
            MQTT topic for control messages to the Pool Interface

    config OPNPOOL_DBGLVL_DATALINK
        int "Datalink/RS485 layer debug level"
        default 1
        help
            0 for no debug, 1 for errors only, 2 for all

    config OPNPOOL_DBGLVL_NETWORK
        int "Network layer debug level"
        default 1
        help
            0 for no debug, 1 for errors only, 2 for all

    config OPNPOOL_DBGLVL_POOLSTATE
        int "Poolstate debug level"
        default 1
        help
            0 for no debug, 1 for errors only, 2 for all

    config OPNPOOL_DBGLVL_POOLTASK
        int "Pool task debug level"
        default 1
        help
            0 for no debug, 1 for errors only, 2 for all

    config OPNPOOL_DBGLVL_MQTTTASK
        int "MQTT task debug level"
        default 1
        help
            0 for no debug, 1 for errors only, 2 for all

    config OPNPOOL_DBGLVL_HASSTASK
        int "Home assistant task debug level"
        default 2
        help
            0 for no debug, 1 for errors only, 2 for all

    config OPNPOOL_DBGLVL_HTTPD
        int "HTTPd debug level"
        default 1
        help
            0 for no debug, 1 for errors only, 2 for all

    config OPNPOOL_DBGLVL_IPC
        int "IPC debug level"
        default 0
        help
            0 for no debug, 1 for errors only, 2 for all

    config OPNPOOL_HARDCODED_WIFI_CREDENTIALS
        bool "Use hardcoded Wi-Fi credentials"
        default n
        help
            Use a hardcoded Wi-Fi credentials. Defaults to n for BLE provisioning.
            
    config OPNPOOL_HARDCODED_WIFI_SSID
        string "WiFi SSID"
        default ""
        depends on OPNPOOL_HARDCODED_WIFI_CREDENTIALS
        help
            SSID (network name).

    config OPNPOOL_HARDCODED_WIFI_PASSWD
        string "WiFi Password"
        default ""
        depends on OPNPOOL_HARDCODED_WIFI_CREDENTIALS
        help
            WiFi password (WPA or WPA2).
        
    config OPNPOOL_HARDCODED_MQTT_CREDENTIALS
        bool "Use hardcoded MQTT URL"
        default n
        help
            Use a hardcoded MQTT credentials. Defaults to n for BLE provisioning.
            
    config OPNPOOL_HARDCODED_MQTT_URL
        string "Hardcoded MQTT broker url endpoint"
        default "mqtt://mqtt:passwd@host.domain:1883"
        depends on OPNPOOL_HARDCODED_MQTT_CREDENTIALS
        help
            Hardcoded MQTT_URL. E.g. mqtt://mqtt:passwd@host.domain:1883.        

endmenu
```

## interface/main/Kconfig.example
```kconfig
menu "Pool Interface"

    config OTA_UPDATE_FIRMWARE_URL
        string "Firmware upgrade url endpoint"
        default "http://host:80/path/interface.bin"
        help
            URL of server which hosts the firmware image. (make sure it matches Kconfig in factory dir)

    config OTA_UPDATE_RECV_TIMEOUT
        int "OTA Update receive Timeout"
        default 5000
        help
            Maximum time for reception [sec]

    config OPNPOOL_RS485_RXPIN
        int "RS485 Rx GPIO# on ESP32"
        default 25
        help
            Receive GPIO# on ESP32 that connects to RO on the RS-485 Transceiver

    config OPNPOOL_RS485_TXPIN
        int "RS485 Tx GPIO# on ESP32"
        default 26
        help
            Transmit GPIO# on ESP32 that connects to DI on the RS-485 Transceiver

    config OPNPOOL_RS485_RTSPIN
        int "RS485 RTS GPIO# on ESP32"
        default 27
        help
            Request-To-Send GPIO# on ESP32 that connects to DE/!RE on the RS-485 Transceiver

    config OPNPOOL_RS485_TIMEOUT
        int "RS485 timeout [ms]"
        default 100
        help
            Maximum time to wait for a byte on RS485

    config OPNPOOL_MQTT_DATA_TOPIC
        string "MQTT broker uri"
        default "pool/data"
        help
            MQTT topic for data from the Pool Interface

    config OPNPOOL_MQTT_CTRL_TOPIC
        string "MQTT broker uri"
        default "pool/ctrl"
        help
            MQTT topic for control messages to the Pool Interface

    config OPNPOOL_DBGLVL_DATALINK
        int "Datalink/RS485 layer debug level"
        default 1
        help
            0 for no debug, 1 for errors only, 2 for all

    config OPNPOOL_DBGLVL_NETWORK
        int "Network layer debug level"
        default 1
        help
            0 for no debug, 1 for errors only, 2 for all

    config OPNPOOL_DBGLVL_POOLSTATE
        int "Poolstate debug level"
        default 2
        help
            0 for no debug, 1 for errors only, 2 for all

    config OPNPOOL_DBGLVL_POOLTASK
        int "Pool task debug level"
        default 1
        help
            0 for no debug, 1 for errors only, 2 for all

    config OPNPOOL_DBGLVL_MQTTTASK
        int "MQTT task debug level"
        default 1
        help
            0 for no debug, 1 for errors only, 2 for all

    config OPNPOOL_DBGLVL_HASSTASK
        int "Home assistant task debug level"
        default 1
        help
            0 for no debug, 1 for errors only, 2 for all

    config OPNPOOL_DBGLVL_HTTPD
        int "HTTPd debug level"
        default 2
        help
            0 for no debug, 1 for errors only, 2 for all

    config OPNPOOL_USE_HARDCODED_MQTT_URL
        bool "Use hardcoded MQTT URL"
        default n
        help
            Use a hardcoded MQTT URL instead of the MQTT_URL from flash memory.
            
    config OPNPOOL_MQTT_URL
        string "Hardcoded MQTT broker url endpoint"
        default "mqtt://mqtt:passwd@host.domain:1883"
        depends on OPNPOOL_USE_HARDCODED_MQTT_URL
        help
            Hardcoded MQTT_URL.  E.g. mqtt://mqtt:passwd@host.domain:1883.        

endmenu
```

## interface/sdkconfig.defaults
```kconfig
# factory binary is larger than default size
CONFIG_PARTITION_TABLE_CUSTOM=y
CONFIG_PARTITION_TABLE_CUSTOM_FILENAME="partitions.csv"
CONFIG_PARTITION_TABLE_FILENAME="partitions.csv"

# need 4 MByte flash for OTA updates
CONFIG_ESPTOOLPY_FLASHSIZE_4MB=y

# prevent 431 status on httpd server
CONFIG_HTTPD_MAX_REQ_HDR_LEN=1024

# coredumping
CONFIG_ESP32_ENABLE_COREDUMP_TO_FLASH=y
CONFIG_ESP32_COREDUMP_DATA_FORMAT_ELF=y
CONFIG_ESP32_CORE_DUMP_STACK_SIZE=1024

# heap debug w/ JTAG
CONFIG_HEAP_POISONING_LIGHT=y
CONFIG_HEAP_TRACING_STANDALONE=y
CONFIG_HEAP_TRACING_STACK_DEPTH=10
#CONFIG_HEAP_TRACING_TOHOST=y
#CONFIG_APPTRACE_DEST_TRAX=y
#CONFIG_APPTRACE_ENABLE=y
#CONFIG_SYSVIEW_ENABLE=y
```

## sdkconfig.defaults
```kconfig
# I don't think this file is honored by ESPHome/PlatformIO

# OPNpool ESP-IDF SDK configuration defaults
# These options are applied during the ESP-IDF build

# Increase main task stack size for complex operations
CONFIG_ESP_MAIN_TASK_STACK_SIZE=8192

# Flash size configuration (ESP32-C6-DevKitC-1 has 8MB flash)
CONFIG_ESPTOOLPY_FLASHSIZE_8MB=y

# OpenThread settings (when using Thread networking)
# CONFIG_OPENTHREAD_ENABLED=y
# CONFIG_OPENTHREAD_FTD=y
```
